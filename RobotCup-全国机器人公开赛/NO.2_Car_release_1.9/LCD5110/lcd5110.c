#include <stm32f10x_lib.h>
#include "lcd5110.h"
void gp_Init(void)
{

//GPIOC->CRL&=0X00FFFFFF;
//GPIOC->CRL|=0X33000000;//PA2-7 推挽输出
//GPIOC->CRH&=0XFFFFFF00;
//GPIOC->CRH|=0X00000033;//PA2-7 推挽输出
//GPIOB->CRL&=0XFFFFFF00;
//GPIOB->CRL|=0X00000033;//PA2-7 推挽输出
//GPIOC->ODR|=1<<6; //PA2 输出高
//GPIOC->ODR|=1<<7; //PA3 输出高
//GPIOC->ODR|=1<<8; //PA4 输出高
//GPIOC->ODR|=1<<9; //PA5 输出高
//GPIOB->ODR|=1<<0; //PA6 输出高
//GPIOB->ODR|=1<<1; //PA7 输出高
	RCC->APB2ENR|=1<<2; //使能PORTA时钟
	RCC->APB2ENR|=1<<4; //使能PORTC时钟
	RCC->APB2ENR |= 1<<5;
	GPIOD->CRL &= 0XF0FFFFFF;
	GPIOD->CRL |= 0X03000000;	  //PD6,推挽输出	50MHZ
	GPIOC->CRL&=0XF0FFFFFF;
    GPIOC->CRL|=0X03000000;
	GPIOA->CRH&=0XFF000FFF;
    GPIOA->CRH|=0X00333000;//PA11-13 推挽输出

	GPIOA->ODR |= 1<<11;
	GPIOA->ODR |= 1<<12;
	GPIOA->ODR |= 1<<13;
	GPIOC->ODR |= 1<<6;
	GPIOD->ODR |= 1<<6;
}
//一个字符占8行5列
//BL pb1
//clk pb0
//din pc6
//dc  pc7
//rst pc8
//ce  pc9
u8 ap[]={0x40,0x20,0xF8,0x07,0x40,0x20,0x18,0x0F,
      0x08,0xC8,0x08,0x08,0x28,0x18,0x00,0x00,
      0x00,0x00,0xFF,0x00,0x00,0x08,0x04,0x43,
      0x80,0x7F,0x00,0x01,0x06,0x0C,0x00,0x00};
uchar  ascii_dot[] =        // ASCII表
{		          
	0x00,0x00,0x00,0x00,0x00, // - -
	0x00,0x00,0x5F,0x00,0x00, // -!-
	0x00,0x07,0x00,0x07,0x00, // -"-
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	0x55,0x2A,0x55,0x2A,0x55 // --
};	

uchar  add[][5]={
	{0x3E,0x51,0x49,0x45,0x3E}, // -0-
	{0x00,0x42,0x7F,0x40,0x00}, // -1-
	{0x62,0x51,0x49,0x49,0x46}, // -2-
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	{0x46,0x49,0x49,0x29,0x1E} // -9-
};	 
void Write_Data(uchar DC,uchar Data)	//由DIN写入的函数
{	
	uchar n;
	N5110_CE_L();
    if(DC==1)
	{
	N5110_DC_D();
	}
	else
	{
	 N5110_DC_C();
	}								    
	 for(n=0;n<8;n++)
	 {
	 	if((Data&0x80)!=0)
		{
			N5110_DIN_H();
	    }
		else
		{	
		    N5110_DIN_L();
        }
		N5110_CLK_L();
		Data<<=1;
		N5110_CLK_H();
	 }
	 N5110_CE_H();
} 

void write_zuobiao(uchar X,uchar Y)	  //定坐标的函数
{
	Write_Data(0,X|0x80);
	Write_Data(0,Y|0x40);
}
void Clean_Screen(void)	  //清屏函数
{
	int i;
	write_zuobiao(0,0);
	for(i=0;i<504;i++)
	{
		Write_Data(1,0x00);
	}
}
void write_char(char c)		   //输入单个字符的函数
{											
    uint j ;
    uint k =(c-' ')*5;    		
    for(j = 0 ; j< 5 ; j++)						
    {Write_Data(1  , ascii_dot[k+j]);}
}  
void write_string(char *string)
{
	while(*string!=0x00)
	{
		write_char(*string);
		string++;
	}
} 
void N5110_Init(void)					 //初始化函数
{
	gp_Init() ;
	N5110_RST_L() ;
	delay_5110(100);					// N5110芯片复位
	N5110_RST_H() ;
	N5110_CE_H() ;					// 初始不选通N5110芯片,仅在需要写入数据的时候选通芯片
	Write_Data(0, 0x21);   	// 设置功能设置寄存器,芯片活动,水平寻址,使用扩展命令
    Write_Data(0, 0xbe);   	// 设置液晶偏置电压
    Write_Data(0, 0x06);   	// 温度校正
    Write_Data(0, 0x13);   	// 设置偏置系统1:48 
    Write_Data(0, 0x20);   	// 使用基本指令集   
    Write_Data(0, 0x0c);   	// 设置显示模式为 普通模式
    Clean_Screen();    		// 清屏
	// N5110_BL_ON();
}
void display_word(uchar x ,uchar y , uchar *p)		  //根据坐标和要显示的汉字，按照一定的格式在5110上显示出来
{
    uchar q = 0 ;
	write_zuobiao(x,y) ;
	 for(q = 0 ; q < 16 ; q++)				  
		   Write_Data(1 ,*(p+q)) ; 
	 write_zuobiao(x,y+1) ;
	 for(q = 16 ; q <32 ; q++) 
	   Write_Data(1 , *(p+q));

}
void delay_5110(uint x)						   //初始化函数中用到的延迟函数
{
	uint a,b;					   
	for(a=0;a<500;a++)
	 for(b=0;b<x;b++);
}
void display_num_v(uchar x , uchar y , uint num)			 //根据坐标和要显示的数字，显示动态3位数字
{
   uchar i = 0 ;
    write_zuobiao(x , y);
	for(i = 0 ; i<5 ; i++)
	  Write_Data(1 , *(add[num/100]+i)) ;
	write_zuobiao(x+5 , y) ;
    for(i = 0 ; i<5 ; i++)
	  Write_Data(1 , *(add[(num/10)%10]+i)) ;
	write_zuobiao(x+10 , y) ;
	for(i = 0 ; i<5 ; i++)
	  Write_Data(1 , *(add[num%10]+i)) ;
	write_zuobiao(x+15 , y) ;
	  write_char('v') ;
}
void display_num_add(uchar x , uchar y , uint num)			 //根据坐标和要显示的4个数字
{
   uchar i = 0 ;
    write_zuobiao(x , y) ;
	for(i = 0 ; i<5 ; i++)
	  Write_Data(1 , *(add[num/1000]+i)) ;
	write_zuobiao(x+5 , y) ;
    for(i = 0 ; i<5 ; i++)
	  Write_Data(1 , *(add[(num/100)%10]+i)) ;
	write_zuobiao(x+10 , y) ;
	for(i = 0 ; i<5 ; i++)
	  Write_Data(1 , *(add[(num/10)%100%10]+i)) ;
	  	write_zuobiao(x+15 , y) ;
	for(i = 0 ; i<5 ; i++)
	  Write_Data(1 , *(add[num%10]+i)) ;
}
void display_num_ad(uchar x , uchar y , uint num)			 //根据坐标和要显示的2个数字，按照一定的格式在5110上显示出来
{
   uchar i = 0 ;
	write_zuobiao(x , y) ;
    for(i = 0 ; i<5 ; i++)
	  Write_Data(1 , *(add[(num/10)%10]+i)) ;
	write_zuobiao(x+5 , y) ;
	for(i = 0 ; i<5 ; i++)
	  Write_Data(1 , *(add[num%10]+i)) ; }

void display_num_a(uchar x , uchar y , uint num)			 //根据坐标和要显示1个的数字，按照一定的格式在5110上显示出来
{
   uchar i = 0 ;
	write_zuobiao(x , y) ;
	for(i = 0 ; i<5 ; i++)
	  Write_Data(1 , *(add[num%10]+i)) ;
}	   	

void show_string(uchar x , uchar y ,char *string)
{
//		char string1=*string;
		write_zuobiao(x , y) ;
		write_string(string);
}



